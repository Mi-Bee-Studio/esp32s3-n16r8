## cam/main/Kconfig.projbuild
```kconfig
menu "Camera Pin Configuration"

    config CAMERA_PIN_PWDN
        int "Camera pin PWDN"
        default -1
        help
            GPIO number for camera power-down pin.

    config CAMERA_PIN_RESET
        int "Camera pin RESET"
        default -1
        help
            GPIO number for camera reset pin.

    config CAMERA_PIN_XCLK
        int "Camera pin XCLK"
        default 15
        help
            GPIO number for camera XCLK pin.

    config CAMERA_PIN_SIOD
        int "Camera pin SIOD (SCCB data)"
        default 4
        help
            GPIO number for camera SCCB data pin.

    config CAMERA_PIN_SIOC
        int "Camera pin SIOC (SCCB clock)"
        default 5
        help
            GPIO number for camera SCCB clock pin.

    config CAMERA_PIN_D0
        int "Camera pin D0"
        default 11
        help
            GPIO number for camera data bit 0.

    config CAMERA_PIN_D1
        int "Camera pin D1"
        default 9
        help
            GPIO number for camera data bit 1.

    config CAMERA_PIN_D2
        int "Camera pin D2"
        default 8
        help
            GPIO number for camera data bit 2.

    config CAMERA_PIN_D3
        int "Camera pin D3"
        default 10
        help
            GPIO number for camera data bit 3.

    config CAMERA_PIN_D4
        int "Camera pin D4"
        default 12
        help
            GPIO number for camera data bit 4.

    config CAMERA_PIN_D5
        int "Camera pin D5"
        default 18
        help
            GPIO number for camera data bit 5.

    config CAMERA_PIN_D6
        int "Camera pin D6"
        default 17
        help
            GPIO number for camera data bit 6.

    config CAMERA_PIN_D7
        int "Camera pin D7"
        default 16
        help
            GPIO number for camera data bit 7.

    config CAMERA_PIN_VSYNC
        int "Camera pin VSYNC"
        default 6
        help
            GPIO number for camera VSYNC pin.

    config CAMERA_PIN_HREF
        int "Camera pin HREF"
        default 7
        help
            GPIO number for camera HREF pin.

    config CAMERA_PIN_PCLK
        int "Camera pin PCLK"
        default 13
        help
            GPIO number for camera PCLK pin.

    config CAMERA_PSRAM_DMA
        bool "Enable PSRAM DMA mode by default"
        default n
        help
            Enable DMA transfers directly from PSRAM.

endmenu

menu "mibee-cam CSI Motion Sensing (ESPectre)"

    config MIBEE_CSI_MOTION
        bool "Enable ESPectre WiFi CSI motion sensing"
        default n
        select ESP_WIFI_CSI_ENABLED if SOC_WIFI_CSI_SUPPORT
        help
            Embed the ESPectre sensing runtime (components/espectre, GPLv3)
            and start it after WiFi init. Logs motion-state changes only —
            no API/contract surface yet (family pilot, 2026-09-06). Detection
            profile / CSI cadence are tuned under "ESPectre Sensing".
            With this option off the firmware is byte-identical to the
            pre-ESPectre baseline (verified on seeed 2026-09-06).

endmenu
```

## usb-webcam/main/Kconfig.projbuild
```kconfig
# SPDX-License-Identifier: GPL-3.0-or-later
menu "MiBee USB Webcam Configuration"

    choice CAMERA_MODULE
        prompt "Camera module pin map"
        default CAMERA_MODULE_GOOUUU_N16R8
        help
            本项目只服务 GOOUUU ESP32-S3-N16R8 相机板（引脚表与 cam/ 子项目
            sdkconfig.defaults 同源）。换板时在 camera_pin.h 加块 + 这里加选项。

        config CAMERA_MODULE_GOOUUU_N16R8
            bool "GOOUUU ESP32-S3-N16R8 (OV5640/OV3660)"
    endchoice

    choice CAMERA_XCLK_FREQ_CHOICE
        prompt "Camera XCLK frequency (MHz)"
        default CAMERA_XCLK_16M
        help
            16MHz：cam 仓上板结论（XGA+ 稳定的必要条件）；20MHz 为 esp32-camera
            传统默认。VGA 两者皆可，选 16 与 cam 固件一致。

        config CAMERA_XCLK_10M
            bool "10 MHz"
        config CAMERA_XCLK_16M
            bool "16 MHz"
        config CAMERA_XCLK_20M
            bool "20 MHz"
    endchoice

    config CAMERA_XCLK_FREQ
        int
        default 10 if CAMERA_XCLK_10M
        default 16 if CAMERA_XCLK_16M
        default 20 if CAMERA_XCLK_20M

    config CAMERA_VFLIP
        bool "Vertical flip"
        default n
        help
            传感器垂直翻转（安装倒装时开）。

    config CAMERA_HMIRROR
        bool "Horizontal mirror"
        default n

endmenu
```
